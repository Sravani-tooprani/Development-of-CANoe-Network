/*@!Encoding:1252*/
includes
{
  
}

variables
{
  message 0x100 b;
  message 0x101 c;
  msTimer t1,t2;
  int t=1;
}

on key *{
  setTimer(t1,50);
}
on timer t1
{
  if(t<=30){
    b.BCM_Signal=!(b.BCM_Signal);
    output(b);
    write("BCMMessage");
    t++;
    setTimer(t1,50);
  }
  else{
    setTimer(t2,100);
   }
}
on timer t2
  {
    if(t<=80)
    {
      output(c);
      write("GWMMessage");
      t++;
      settimer(t2,100);
    }
    else{
      settimer(t1,50);
      t=1;}
    

  
  
    
 
}