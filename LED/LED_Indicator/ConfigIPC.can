/*@!Encoding:1252*/
includes
{
  
}

variables
{
  
}

on message BCMMessage
{
  putValue(Env_IPC,this.BCM_Signal);
}

