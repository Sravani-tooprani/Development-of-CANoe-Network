VERSION ""

NS_ :

BS_:

BU_: IPC BCM
VAL_TABLE_ Config_Positions 1 "ON" 0 "OFF" ;

BO_ 256 BCMMessage: 1 BCM
 SG_ BCM_Signal : 0|1@1+ (1,0) [0|1] "" Vector__XXX

EV_ Env_IPC: 0 [0|1] "" 0 1 DUMMY_NODE_VECTOR0 Vector__XXX;

EV_ Env_BCM: 0 [0|1] "" 0 2 DUMMY_NODE_VECTOR0 Vector__XXX;

VAL_ 256 BCM_Signal 1 "ON" 0 "OFF" ;
VAL_ Env_IPC 1 "ON" 0 "OFF" ;
VAL_ Env_BCM 1 "ON" 0 "OFF" ;
